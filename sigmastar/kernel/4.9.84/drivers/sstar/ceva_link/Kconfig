## sigmastar/kernel/4.9.84/drivers/sstar/clocksource/Kconfig
```kconfig
config MS_CA9_GT_CLOCKSOURCE
    bool    "ARM CA9 GT Timer for clocksource"
    depends on ARCH_CEDRIC
    depends on ARM_GLOBAL_TIMER
    
config MS_PIU_TIMER
    bool    "PIU Timer driver"    
```

## sigmastar/kernel/4.9.84/drivers/sstar/cpufreq/Kconfig
```kconfig
config MS_CPU_FREQ
	tristate "Mstar CPU frequency scaling driver"
    select CPU_FREQ
    select CPU_FREQ_STAT_DETAILS
    select CPU_FREQ_GOV_POWERSAVE
    select CPU_FREQ_GOV_ONDEMAND
    select CPU_FREQ_GOV_USERSPACE
    select PM_OPP
```

## sigmastar/kernel/4.9.84/drivers/sstar/crypto/Kconfig
```kconfig
config MS_CRYPTO
	tristate "Crypto driver"
	select CRYPTO_AES
	select CRYPTO_ECB
	select CRYPTO_CBC
	select CRYPTO_SHA256
	select CRYPTO_CTR
	select CRYPTO_ALGAPI

---help---
	Say 'Y' here to use the sstar AES engine
	for the CryptoAPI AES algorithm.
	To compile this driver as a module, choose M here: the module


config SS_AESDMA_INTR
depends on MS_CRYPTO
bool "Enable AES DMA interrupt"
default n
help
	Support interrupt mode for AES operations

config CRYPTODEV
tristate "Support cryptodev"
default m
help
	Support \dev\crypto
```

## sigmastar/kernel/4.9.84/drivers/sstar/emac/Kconfig
```kconfig
config MS_EMAC
select NET
select NET_ETHERNET
select MII
select PACKET
select USE_POLICY_FWD
select INET
select NETDEVICES

tristate "EMAC"
default n

---help---
Enable compilation option for driver EMAC

if MS_EMAC
config EMAC_SUPPLY_RNG
bool "Supply to random number generator device"
default n
help
    Supply to random number generator device

config MSTAR_HW_TX_CHECKSUM
bool "Supply to hardware TX checksum"
default n
help
    Supply to hardware TX checksum
    
config K3_RX_SWPATCH
bool "Supply to K3 RX SW Patch"
default n
help
    Supply to K3 RX frame drop due to padding 4 bytes issue

config DISCONNECT_DELAY_S
int "Disconnect delay in second"
default 1
help
    Disconnect delay in second

config MSTAR_EEE
bool "Supply to EEE function"
default n
help
    Supply to EEE function

config EMAC_PHY_RESTART_AN
bool "Supply to phy restart AN"
default n
help
    Supply to phy restart AN

config EMAC_SPEED10_HALF_PATCH
bool "Supply to speed 10M duplex half patch"
default n
help
    Supply to hw write out of range to skb in 10M half case
endif
```

## sigmastar/kernel/4.9.84/drivers/sstar/emmc/Kconfig
```kconfig
config MS_EMMC
	tristate "EMMC driver"
	depends on MMC
	help
    		To enable MSTAR EMMC driver.
    		
config MS_EMMC_CEDRIC
    tristate "EMMC support for Cedric"
    depends on MS_EMMC
    depends on ARCH_CEDRIC    		

    
config MS_EMMC_CHICAGO
    tristate "EMMC support for Chicago"
    depends on MS_EMMC
    depends on ARCH_CHICAGO

config MS_EMMC_UNIFY_DRIVER
    bool "UNIFY EMMC DRIVER"
    depends on MS_EMMC
```

## sigmastar/kernel/4.9.84/drivers/sstar/flash_isp/Kconfig
```kconfig
config MS_FLASH_ISP

  select MTD
  #select MTD_CHAR
  #select MTD_BLKDEVS
  #select NFTL
  #select NFTL_RW
  #select MTD_OOPS

  #select MTD_COMPLEX_MAPPINGS
  #select MTD_BLOCK2MTD
  #select MTD_CMDLINE_PARTS
  #select SCSI_LOWLEVEL
  #select AUTOFS_FS

  #select FAT_FS
  #select MSDOS_FS
  #select VFAT_FS

  #select MTD_DEBUG
  #select MTD_DEBUG_VERBOSE
  #select MTD_CONCAT
  #select MTD_PARTITIONS
  #select MTD_NAND
  #select JFFS2_FS
  #select JFFS2_FS_DEBUG
  #select JFFS2_FS_WRITEBUFFER

bool "Serial Flash driver"
default n
---help---
    Enable compilation option for Serial Flash.
    FSP support Quadread/Daulread/write with BDMA.

if MS_FLASH_ISP
config MS_FLASH_ISP_MXP_PARTS
    bool
    default y

choice
    prompt "READ "
    default NOR_SINGLE_READ
    config NOR_SINGLE_READ
        bool "Use fast read"
    config NOR_QUAL_READ
        bool "Use quad read"
endchoice

choice
    prompt "WRITE"
    default NOR_SINGLE_WRITE
    config NOR_SINGLE_WRITE
        bool "Use fast write"
    config NOR_QUAL_WRITE
        bool "Use quad write"
endchoice

config SS_FLASH_ISP_WP
    bool "Serial Flash Write Protect Support"
    default n
    depends on MS_FLASH_ISP
    help
      Support serial flash write protect function.

endif
```

## sigmastar/kernel/4.9.84/drivers/sstar/gmac/Kconfig
```kconfig
config MS_GMAC
select NET
select NET_ETHERNET
select MII
select PACKET
select USE_POLICY_FWD
select INET
select NETDEVICES

tristate "GMAC"
default n

---help---
Enable compilation option for driver GMAC

if MS_GMAC
menu "MStar GMAC Driver"


choice
    prompt "Default Select PadMux"
    default GMAC_TO_RMII
    depends on MSTAR_KANO || ARCH_INFINITY2

#config KANO_GMAC1_EPHY
#bool "GMAC1 + Internal EPHY"
#help
#    GMAC1 + Internal EPHY

config KANO_GMAC0_GPHY
bool "GMAC0 + RGMII GPHY"
help
    GMAC0 + RGMII GPHY

config GMAC_TO_RMII
bool "GMAC0 + RMII EPHY"
help
    GMAC0 + RMII EPHY

config KANO_GMAC1_GPHY
bool "GMAC1 + RGMII GPHY"
help
    GMAC1 + RGMII GPHY

config GMAC1_TO_RMII
bool "GMAC1 + RMII EPHY"
help
    GMAC1 + RMII EPHY
endchoice

choice
    prompt "Force MAC mode"
    default GMAC_DETECT_FROM_PHY

config GMAC_DETECT_FROM_PHY
bool "Auto-polling speed&duplex from phy"

config GMAC_FORCE_MAC_SPEED_100
bool "Force MAC speed to 100M"
depends on GMAC1_TO_RMII || GMAC_TO_RMII
endchoice

config  GMAC_EXT_PHY_ADDR
    hex "Phy Address"
    default 0x1

config GMAC_RX_Memory_Copy
bool "Memory_Copy"

choice
    prompt "Select RX Method"
    default GMAC_Memory_Copy

config GMAC_RX_Memory_Copy
bool "Memory_Copy"
help
    Use memcpy and additional RX buffer for RX callback function

config GMAC_RX_DMA
bool "DMA"
help
    GMAC Direct access Kernel Memory in RX callback function.
    K6, K6lite, k7 can only use one MIU for kernel Memory.

endchoice

config GMAC_RX_NAPI
bool "Enable RX_NAPI"
default y
help
    Enable NAPI Method. Disable interrupt during heavy tracffic.


config GMAC_RX_NAPI_WEIGHT
int "RX_NAPI_WEIGHT"
depends on GMAC_RX_NAPI
default 64
help
    NAPI Weight


config GMAC_RX_GRO
bool "Enable RX_GRO"
default y
help
    Enable Generic receive offload. Merge packet with same destination and source


config GMAC_RX_DELAY_INTERRUPT
bool "Enable RX Delay Interrupt"
default y
help
    Enable RX Delay Interrupt. Reduce interrupt number.


config GMAC_DELAY_INTERRUPT_NUMBER
int "Packet Threshold"
depends on GMAC_RX_DELAY_INTERRUPT
default 64
help
    MAX 255

config GMAC_DELAY_INTERRUPT_TIMEOUT
int "Timeout"
depends on GMAC_RX_DELAY_INTERRUPT
default 6
help
    MAX 255

choice
    prompt "Select TX Queue"
    default GMAC_TX_DESC_MODE if MSTAR_K6Lite
    default GMAC_NEW_TX_QUEUE_V3 if MSTAR_K6
    default GMAC_TX_4_QUEUE

config GMAC_TX_4_QUEUE
bool "Default TX Queue"
help
    Use default TX Queue 4.

config GMAC_NEW_TX_QUEUE_V3
bool "Enable Additional New TX Queue"
depends on MSTAR_K6Lite || MSTAR_K6 || ARCH_INFINITY2
help
    Enable New TX Queue. Larger TX Queue. Kayla support

config GMAC_TX_DESC_MODE
bool "Enable TX dexcriptor Mode"
depends on MSTAR_K6Lite || ARCH_INFINITY2
help
    Enable TX dexcriptor Mode. Use DRAM for TX QUEUE.
endchoice

config GMAC_NEW_TX_QUEUE_THRESHOLD_V3
int "New TX Queue Threshold"
depends on GMAC_NEW_TX_QUEUE_V3
default 60
help
    MAX 63

config GMAC_SUPPLY_RNG
bool "Supply to random number generator device"
default n
help
    Supply to random number generator device


config MSTAR_GMAC_HW_TX_CHECKSUM
bool "Supply to hardware TX checksum"
default n
help
    Supply to hardware TX checksum

config MSTAR_GMAC_JUMBO_PACKET
bool "Supply to jumbo packet"
default n
help
    Supply to jumbo packet

endmenu #"MStar GMAC Driver"

endif
```

## sigmastar/kernel/4.9.84/drivers/sstar/gmac/Kconfig.old
```kconfig
config MS_GMAC
select NET
select NET_ETHERNET
select MII
select PACKET
select USE_POLICY_FWD
select INET
select NETDEVICES

tristate "GMAC"
default n

---help---
Enable compilation option for driver GMAC

if MS_GMAC
menu "MStar GMAC Driver"


choice
    prompt "Default Select PadMux"
    default GMAC_TO_RMII
    depends on MSTAR_KANO || ARCH_INFINITY2

#config KANO_GMAC1_EPHY
#bool "GMAC1 + Internal EPHY"
#help
#    GMAC1 + Internal EPHY

config KANO_GMAC0_GPHY
bool "GMAC0 + external GPHY"
help
    GMAC0 + external GPHY

config GMAC_TO_RMII
bool "GMAC0 + external EPHY"
help
    GMAC0 + external EPHY

config KANO_GMAC1_GPHY
bool "GMAC1 + external GPHY"
help
    GMAC1 + external GPHY

config GMAC1_TO_RMII
bool "GMAC1 + external EPHY"
help
    GMAC1 + external EPHY
endchoice


choice
    prompt "Select RX Method"
    default GMAC_Memory_Copy

config GMAC_RX_Memory_Copy
bool "Memory_Copy"
help
    Use memcpy and additional RX buffer for RX callback function

config GMAC_RX_DMA
bool "DMA"
help
    GMAC Direct access Kernel Memory in RX callback function.
    K6, K6lite, k7 can only use one MIU for kernel Memory.

endchoice

config GMAC_RX_NAPI
bool "Enable RX_NAPI"
default y
help
    Enable NAPI Method. Disable interrupt during heavy tracffic.


config GMAC_RX_NAPI_WEIGHT
int "RX_NAPI_WEIGHT"
depends on GMAC_RX_NAPI
default 64
help
    NAPI Weight


config GMAC_RX_GRO
bool "Enable RX_GRO"
default y
help
    Enable Generic receive offload. Merge packet with same destination and source


config GMAC_RX_DELAY_INTERRUPT
bool "Enable RX Delay Interrupt"
default y
help
    Enable RX Delay Interrupt. Reduce interrupt number.


config GMAC_DELAY_INTERRUPT_NUMBER
int "Packet Threshold"
depends on GMAC_RX_DELAY_INTERRUPT
default 64
help
    MAX 255

config GMAC_DELAY_INTERRUPT_TIMEOUT
int "Timeout"
default 6
help
    MAX 255


choice
    prompt "Select TX Queue"
    default GMAC_TX_DESC_MODE if MSTAR_K6Lite
    default GMAC_NEW_TX_QUEUE_V3 if MSTAR_K6
    default GMAC_TX_4_QUEUE

config GMAC_TX_4_QUEUE
bool "Default TX Queue"
help
    Use default TX Queue 4.

config GMAC_NEW_TX_QUEUE_V3
bool "Enable Additional New TX Queue"
depends on MSTAR_K6Lite || MSTAR_K6 || ARCH_INFINITY2
help
    Enable New TX Queue. Larger TX Queue. Kayla support

config GMAC_TX_DESC_MODE
bool "Enable TX dexcriptor Mode"
depends on MSTAR_K6Lite || ARCH_INFINITY2
help
    Enable TX dexcriptor Mode. Use DRAM for TX QUEUE.

endchoice

if GMAC_NEW_TX_QUEUE_V3
config GMAC_NEW_TX_QUEUE_THRESHOLD_V3
int "New TX Queue Threshold"
default 60
help
    MAX 63

endif

#config MSTAR_GMAC_V2
#bool "GMAC V2"
#default n
#help
#    GMAC V2 architecture. Zero memcpy in RX, pre-allocate ring buffer

if MSTAR_GMAC_V2
config GMAC_RX_CMA
bool "Support RX skb allocated from CMA buffer"
default n
help
    Support RX skb allocated from CMA buffer

config GMAC_TX_ENHANCEMENT
bool "Select TX enhancement"
default n
help
    Select TX enhancement

if GMAC_TX_ENHANCEMENT

choice
    prompt "TX enhancement select"
    default GMAC_NEW_TX_QUEUE

config GMAC_NEW_TX_QUEUE
bool "Use new TX queue hardware design"
help
    Use new TX queue hardware design, it's now supported on K6.

if GMAC_NEW_TX_QUEUE
config GMAC_NEW_TX_QUEUE_THRESHOLD
int "New TX queue threshold"
default 60
help
    New TX queue threshold
endif

config GMAC_TX_ZERO_COPY_SW_QUEUE
bool "Support TX zero copy with software queue"
help
    Support TX zero copy with software queue

endchoice

endif

config GMAC_ISR_BOTTOM_HALF
bool "Support ISR bottom-half"
default n
help
    Support ISR bottom-half

if GMAC_ISR_BOTTOM_HALF

choice
    prompt "GMAC ISR BH select"
    default GMAC_ISR_BH_NAPI

config GMAC_ISR_BH_TASKLET
bool "Use tasklet for bottom-half"
help
    Use tasklet for bottom-half

config GMAC_ISR_BH_NAPI
bool "Use NAPI for bottom-half"
help
    Use NAPI for bottom-half

if GMAC_ISR_BH_NAPI
config GMAC_NAPI_WEIGHT
int "NAPI weight"
default 64
help
    NAPI weight

config GMAC_NAPI_GRO
bool "Use NAPI GRO mechanism"
default n
help
    Use NAPI GRO mechanism
endif

endchoice

endif
endif

config GMAC_SUPPLY_RNG
bool "Supply to random number generator device"
default n
help
    Supply to random number generator device

#config GMAC_ETHERNET_ALBANY
#bool "Supply to internel PHY"
#default n
#help
#    Supply to internel PHY

config MSTAR_GMAC_HW_TX_CHECKSUM
bool "Supply to hardware TX checksum"
default n
help
    Supply to hardware TX checksum

config MSTAR_GMAC_JUMBO_PACKET
bool "Supply to jumbo packet"
default n
help
    Supply to jumbo packet

#config MSTAR_GMAC_RMII_DOWNGRADE_MODE
#bool "Supply GMAC to use external EPHY by RMII"
#default n
#help
#    Supply to GMAC use external RMII EPHY

endmenu #"MStar GMAC Driver"

endif
```

## sigmastar/kernel/4.9.84/drivers/sstar/gpio/Kconfig
```kconfig
config MS_GPIO
    tristate "GPIO driver"
    default y
    help

config MS_SW_I2C
    tristate "SW I2C via GPIO support"
    depends on MS_GPIO
```

## sigmastar/kernel/4.9.84/drivers/sstar/i2c/Kconfig
```kconfig
config MS_I2C
    tristate "Sstar I2C driver"
    help
        Sstar I2C driver function

config MS_I2C_INT_ISR
    bool "Support I2c ISR"
    depends on MS_I2C
    default n
    help
        Support I2c ISR
```

## sigmastar/kernel/4.9.84/drivers/sstar/include/infinity2/Kconfig
```kconfig
source "drivers/sstar/ive/Kconfig"
source "drivers/sstar/warp/Kconfig"
source "drivers/sstar/emac/Kconfig"
source "drivers/sstar/vcore_dvfs/Kconfig"
source "drivers/sstar/ceva_link/Kconfig"
source "drivers/sstar/gmac/Kconfig"
source "drivers/sstar/noe/Kconfig"
source "drivers/sstar/miu/Kconfig"
source "drivers/sstar/bdma/Kconfig"
source "drivers/sstar/movedma/Kconfig"
source "drivers/sstar/sata_host/Kconfig"
```

## sigmastar/kernel/4.9.84/drivers/sstar/include/infinity2m/Kconfig
```kconfig
source "drivers/sstar/emmc/Kconfig"
source "drivers/sstar/sdmmc/Kconfig"
source "drivers/sstar/emac/Kconfig"
source "drivers/sstar/crypto/Kconfig"
source "drivers/sstar/cpufreq/Kconfig"
source "drivers/sstar/miu/Kconfig"
source "drivers/sstar/bdma/Kconfig"
source "drivers/sstar/movedma/Kconfig"
source "drivers/sstar/sata_host/Kconfig"
```

## sigmastar/kernel/4.9.84/drivers/sstar/include/infinity3/Kconfig
```kconfig
#source "drivers/sstar/isp/Kconfig"
#source "drivers/sstar/sound/Kconfig"
source "drivers/sstar/emmc/Kconfig"
source "drivers/sstar/sdmmc/Kconfig"
source "drivers/sstar/usb/Kconfig"
#source "drivers/sstar/fb/Kconfig"
#source "drivers/sstar/fb1/Kconfig"
#source "drivers/sstar/fb2/Kconfig"
#source "drivers/sstar/scl/Kconfig"
source "drivers/sstar/emac/Kconfig"
source "drivers/sstar/ircut/Kconfig"
#source "drivers/sstar/vhe/Kconfig"
#source "drivers/sstar/mfev5/Kconfig"
source "drivers/sstar/rtc/Kconfig"
#source "drivers/sstar/jpe/Kconfig"
source "drivers/sstar/xpm/Kconfig"
source "drivers/sstar/crypto/Kconfig"
source "drivers/sstar/cpufreq/Kconfig"
source "drivers/sstar/notify/Kconfig"
```

## sigmastar/kernel/4.9.84/drivers/sstar/include/infinity6b0/Kconfig
```kconfig
source "drivers/sstar/emmc/Kconfig"
source "drivers/sstar/sdmmc/Kconfig"
source "drivers/sstar/emac/Kconfig"
source "drivers/sstar/ircut/Kconfig"
source "drivers/sstar/rtc/Kconfig"
source "drivers/sstar/crypto/Kconfig"
source "drivers/sstar/cpufreq/Kconfig"
source "drivers/sstar/ive/Kconfig"
source "drivers/sstar/notify/Kconfig"
source "drivers/sstar/isrcb/Kconfig"
source "drivers/sstar/miu/Kconfig"
source "drivers/sstar/bdma/Kconfig"
source "drivers/sstar/movedma/Kconfig"
```

## sigmastar/kernel/4.9.84/drivers/sstar/ir/Kconfig
```kconfig
config MS_IR

tristate "SStar IR driver"
  default n
  help
  enable support for IR driver
```

## sigmastar/kernel/4.9.84/drivers/sstar/ircut/Kconfig
```kconfig
config MS_IRCUT
        tristate "ircut driver"
        help
          Say Y here to enable the driver for the ircut.

          If unsure, say Y.

          To compile this driver as a module, choose M here: the
          module will be called mdrv_ircut.
```

## sigmastar/kernel/4.9.84/drivers/sstar/isrcb/Kconfig
```kconfig
#config MS_ISRCB
#    boolean "Mstar ISRCB driver"
#    help
#        MStar ISRCB driver function

config SS_ISP_ISRCB
    tristate "ISRCB driver support"
```
