## 18.06/package/esp8089/src/Kconfig
```kconfig
config ESP8089
	tristate "Espressif ESP8089 SDIO WiFi"
	depends on MAC80211
	---help---
	  ESP8089 is a low-budget 2.4GHz WiFi chip by Espressif, used in many
	  cheap tablets with Allwinner or Rockchip SoC

config ESP8089_DEBUG_FS
	bool "Enable DebugFS support for ESP8089"
	depends on ESP8089
	default y
	---help---
	  DebugFS support for ESP8089
```

## 18.06/package/sigmastar/sstar-init/Config.in
```kconfig
if PACKAGE_sstar-init

choice
	prompt "Selected LCD"
	default SSTAR_LCD_CC0702I50R

	config SSTAR_LCD_CC0702I50R
		bool "LCD CC0702I50R(1024*600)"

	config SSTAR_LCD_FRD720X720BK
		bool "LCD FRD720X720BK(720*720, MIPI)"

endchoice

endif
```

## 18.06/package/sigmastar/uboot-sstar/src/arch/arm/cpu/armv7/cedric/Kconfig
```kconfig
if CEDRIC

config SYS_CONFIG_NAME
    default "cedric"
    ---help---
    To load the "include/configs/cedric.h"


config SYS_SOC
    default "cedric"
    ---help---
    To generate correct  "arch/arm/include/asm/arch"
    
config SYS_GENERIC_BOARD
    bool
    default y    
 
config MS_LIB_TYPE_2BYTE_STRING
    string "UBOOT type string, 2 byte only"
    default "00"    
    ---help---
    This can only be edited in defconfig only
    
endif
```

## 18.06/package/sigmastar/uboot-sstar/src/arch/arm/cpu/armv7/chicago/Kconfig
```kconfig
if CHICAGO

config SYS_CONFIG_NAME
    default "chicago"
    ---help---
    To load the "include/configs/chicago.h"


config SYS_SOC
    default "chicago"
    ---help---
    To generate correct  "arch/arm/include/asm/arch"
    
config SYS_GENERIC_BOARD
    bool
    default y    
 
config MS_LIB_TYPE_2BYTE_STRING
    string "UBOOT type string, 2 byte only"
    default "00"    
    ---help---
    This can only be edited in defconfig only
    
endif
```

## 18.06/package/sigmastar/uboot-sstar/src/arch/arm/cpu/armv7/infinity/Kconfig
```kconfig
if INFINITY

config SYS_CONFIG_NAME
    default "infinity"
    ---help---
    To load the "include/configs/infinity.h"


config SYS_SOC
    default "infinity"
    ---help---
    To generate correct  "arch/arm/include/asm/arch"
    
config SYS_GENERIC_BOARD
    bool
    default y    

config VERSION_FPGA
    bool "FPGA version"
    default n
    
endif
```

## 18.06/package/sigmastar/uboot-sstar/src/arch/arm/cpu/armv7/infinity2m/Kconfig
```kconfig
if INFINITY2M

config SYS_CONFIG_NAME
    default "infinity2m"
    ---help---
    To load the "include/configs/infinity2m.h"


config SYS_SOC
    default "infinity2m"
    ---help---
    To generate correct  "arch/arm/include/asm/arch"

config SYS_GENERIC_BOARD
    bool
    default y

config VERSION_FPGA
    bool "FPGA version"
    default n

endif
```

## 18.06/package/sigmastar/uboot-sstar/src/arch/arm/cpu/armv7/infinity3/Kconfig
```kconfig
if INFINITY3

config SYS_CONFIG_NAME
    default "infinity3"
    ---help---
    To load the "include/configs/infinity3.h"


config SYS_SOC
    default "infinity3"
    ---help---
    To generate correct  "arch/arm/include/asm/arch"

config SYS_GENERIC_BOARD
    bool
    default y

config VERSION_FPGA
    bool "FPGA version"
    default n

endif
```

## 18.06/package/sigmastar/uboot-sstar/src/arch/arm/cpu/armv7/infinity5/Kconfig
```kconfig
if INFINITY5

config SYS_CONFIG_NAME
    default "infinity5"
    ---help---
    To load the "include/configs/infinity5.h"


config SYS_SOC
    default "infinity5"
    ---help---
    To generate correct  "arch/arm/include/asm/arch"

config SYS_GENERIC_BOARD
    bool
    default y

config VERSION_FPGA
    bool "FPGA version"
    default n

endif
```

## 18.06/package/sigmastar/uboot-sstar/src/arch/arm/cpu/armv7/infinity6/Kconfig
```kconfig
if INFINITY6

config SYS_CONFIG_NAME
    default "infinity6"
    ---help---
    To load the "include/configs/infinity6.h"


config SYS_SOC
    default "infinity6"
    ---help---
    To generate correct  "arch/arm/include/asm/arch"

config SYS_GENERIC_BOARD
    bool
    default y

config VERSION_FPGA
    bool "FPGA version"
    default n

config SS_BOOTING_PERF
    bool "booting time"
    default y
endif
```

## 18.06/package/sigmastar/uboot-sstar/src/arch/arm/cpu/armv7/infinity6b0/Kconfig
```kconfig
if INFINITY6B0

config SYS_CONFIG_NAME
    default "infinity6b0"
    ---help---
    To load the "include/configs/infinity6b0.h"


config SYS_SOC
    default "infinity6b0"
    ---help---
    To generate correct  "arch/arm/include/asm/arch"

config SYS_GENERIC_BOARD
    bool
    default y

config VERSION_FPGA
    bool "FPGA version"
    default n

config SS_BOOTING_PERF
    bool "booting time"
    default y
endif
```

## 18.06/package/sigmastar/uboot-sstar/src/arch/arm/cpu/armv7/infinity6e/Kconfig
```kconfig
if INFINITY6E

config SYS_CONFIG_NAME
    default "infinity6e"
    ---help---
    To load the "include/configs/infinity6e.h"


config SYS_SOC
    default "infinity6e"
    ---help---
    To generate correct  "arch/arm/include/asm/arch"

config SYS_GENERIC_BOARD
    bool
    default y

config VERSION_FPGA
    bool "FPGA version"
    default n

config SS_BOOTING_PERF
    bool "booting time"
    default y
endif
```

## 18.06/package/sigmastar/uboot-sstar/src/drivers/mstar/Kconfig
```kconfig
config SSTAR_IR
    bool "SSTAR IR"

config MS_ISP_FLASH
    bool "MSTAR ISP NOR FLASH"

config MS_SAVE_ENV_IN_ISP_FLASH
    bool "Save environment to ISP NOR FLASH"
    depends on MS_ISP_FLASH

config MS_MTD_ISP_FLASH
    bool "MTD device for ISP NOR FLASH"
    depends on MS_ISP_FLASH

config MS_PARTITION
    bool 'Enable Mstar partition support'
    depends on MS_ISP_FLASH

config MS_SDMMC
    bool 'MSTAR SDMMC'

config MS_EMMC
    bool 'MSTAR eMMC'

config SUPPORT_EMMC_BOOT
    bool 'Support eMMC BOOT'
    depends on INFINITY6E
    depends on MS_EMMC

config MS_GPIO
    bool 'MSTAR Gpio'
    default y

config MS_NAND
    bool 'MSTAR NAND'

config MS_SAVE_ENV_IN_NAND_FLASH
    bool "Save environment to NAND FLASH"
    depends on MS_NAND

config MS_CMD_EYE
    bool 'EYE'

config MS_USB
    bool 'MSTAR USB'

config MS_EMAC
    select CMD_NET
    bool 'MSTAR EMAC'

config MS_EMAC1
    bool "MSTAR EMAC 1"
    depends on MS_EMAC

config ETHERNET_ALBANY
    bool "Supply to internel PHY"
    depends on MS_EMAC

config ETHERNET_RMII
    bool "Supply to RMII"
    depends on MS_EMAC

config ETHERNET_ICPLUS
    bool "Supply to IC+ Phy"
    depends on MS_EMAC

config ETHERNET_FIXLINK
    bool "EMAC fix link to mii/rmii"
    depends on MS_EMAC

config ENABLE_FIRST_EHC
    bool 'Enable 1st EHC'
    depends on MS_USB

config ENABLE_SECOND_EHC
    bool 'Enable 2nd EHC'
    depends on MS_USB

config ENABLE_THIRD_EHC
    bool 'Enable 3rd EHC'
    depends on MS_USB
    default y

config MS_ENABLE_USB_LAN_MODULE
    bool 'Enable USB lan module'
    depends on MS_USB

config MS_AESDMA
    bool 'Enable AESDMA'

config MS_SPINAND
    bool "MSTAR SPINAND"

choice
    prompt "Read mode"
    default MS_SPINAND_SINGLE_READ
	depends on MS_SPINAND
    config MS_SPINAND_SINGLE_READ
        bool "Use single read"
    config MS_SPINAND_QUAD_READ
        bool "Use Quad read"
endchoice

choice
    prompt "Write mode"
    default MS_SPINAND_SINGLE_WRITE
        depends on MS_SPINAND
    config MS_SPINAND_SINGLE_WRITE
        bool "Use single write"
    config MS_SPINAND_QUAD_WRITE
        bool "Use Quad write"
endchoice

config MS_SAVE_ENV_IN_NAND_FLASH
    bool "Save environment to NAND FLASH"
    depends on MS_SPINAND

config IMAGE_POSTFIX
	string "Append postfix name to compressed file"
	default ""
	help
	  u-boot"CONFIG_IMAGE_POSTFIX"

config SSTAR_DISP
	bool "SSTAR DISP"

config SSTAR_DISP_HDMITX_VGA
	bool "SSTAR DISP HDMITX VGA"

config SSTAR_PNL
	bool "SSTAR PNL"

config SSTAR_HDMITX
	bool "SSTAR HDMITX"

config SSTAR_JPD
	bool "SSTAR JPD"

config SSTAR_RGN
	bool "SSTAR RGN"

config SSTAR_MSPI
    bool "SSTAR MSPI"

config SSTAR_SAR
    bool "SSTAR SAR"
	
config SSTAR_WDT
    bool "SSTAR WDT"

config SSTAR_PWM
    bool "SSTAR PWM"

config SSTAR_UPGRADE_UI
	bool "SSTAR UPGRADE UI"
	depends on SSTAR_RGN
	depends on SSTAR_DISP
```

## 18.06/target/linux/sstar/image/Config.in
```kconfig
config SSTAR_MEM_64MB
	bool "system memory 64MB"
	default y if (TARGET_sstar_ssd20x_WT2011)
```

## sigmastar/kernel/4.9.84/arch/arm/mach-sstar/Kconfig
```kconfig
menuconfig ARCH_SSTAR
    bool "SStar ARM SoCs"

if ARCH_SSTAR

config SS_DUALOS
    bool "SStar Dual-OS"

choice
    prompt "Select types of SStar Dual-OS"
    depends on SS_DUALOS

    config LH_RTOS
        bool "Enable Hypervisor" if ARCH_MULTI_V7
        help
            Enable LH + RTOS.

    config SS_AMP
        bool "Enable SStar AMP" if ARCH_MULTI_V7
        help
            Enable SStar AMP.
endchoice

comment "Options"
config SS_DTB_NAME
    string "Sstar DTB NAME"
    default ""

config SS_BUILTIN_DTB
    bool "Sstar Builtin DTB"
    default y

config MS_L2X0_PATCH
    bool "L2X0 patch"
    depends on CACHE_L2X0
    default y

config MS_KERNEL_TYPE
	string 
	default ""
	
config MS_ARMV7_XIP
    bool
    default y
	depends on XIP_KERNEL


config SSTAR_CHIP_FOLDER
    string
    option env="SSTAR_CHIP_MODEL"

config SSTAR_CHIP_NAME
    string
    default SSTAR_CHIP_FOLDER

config SSTAR_SHORT_NAME
    string "Short Name"
    default ""

config MP_IRQ_TRACE
    bool "MP_IRQ_TRACE"
    default n

config DISABLE_CLK_DEBUGFS_SUPPORT
    bool "Do not support debugfs for clock platform"
    default y

config SKIP_SQUASHFS_BAD_BLOCK
    bool "Skip squashfs bad block"
    depends on MTD
    default y

config DEFERRED_INIICALLS
    bool "support deferred initcalls"
    default y

config DEFERRED_INIICALLS_SLAB_SYSFS
    bool "defer slab_sysfs_init"
    depends on DEFERRED_INIICALLS
    default n

config DEFERRED_INIICALLS_PARAM_SYSFS
    bool "defer param_sysfs_init"
    depends on DEFERRED_INIICALLS
    default n

config DEFERRED_INIICALLS_PPERF_SYSFS
    bool "defer perf_event_sysfs_init"
    depends on DEFERRED_INIICALLS
    default n

config DEFERRED_INIICALLS_MORE_SYSFS
    bool "defer irq_sysfs_init, init_clocksource_sysfs,clockevents_init_sysfs"
    depends on DEFERRED_INIICALLS
    default n

config DEFERRED_CREATE_DTS_SYSNODE
    bool "defer of_core_init"
    depends on DEFERRED_INIICALLS
    default n

config CRYPTO_MANAGER_NO_TESTS_THREAD
    bool "Do not create cryto test thread"
    depends on CRYPTO_MANAGER_DISABLE_TESTS
    default n

source "arch/arm/mach-sstar/$SSTAR_CHIP_NAME/Kconfig"

endif
```

## sigmastar/kernel/4.9.84/arch/arm/mach-sstar/infinity2/Kconfig
```kconfig
config ARCH_INFINITY2
    bool "SoC iNfinity2 (ARCH_MULTI_V7)"
    select SOC_BUS
    select ARM_GIC
    select VFP
    select VFPv3
    select WIRELESS_EXT if WIRELESS && NET
    select WEXT_PRIV    if WIRELESS && NET
    select HAVE_ARM_SCU if SMP
    select ARM_GLOBAL_TIMER
    select CACHE_L2X0
    help
      Support for iNfinity2 SoC

config SS_PROFILING_TIME
    bool "Record timestamp in sram"
    default n

config MP_PLATFORM_GIC_SET_MULTIPLE_CPUS
	bool "MP_PLATFORM_GIC_SET_MULTIPLE_CPUS"
	depends on SMP
	default y
config MP_GLOBAL_TIMER_CLK
	bool "MP_GLOBAL_TIMER_CLK"
	default y
```

## sigmastar/kernel/4.9.84/arch/arm/mach-sstar/infinity2m/Kconfig
```kconfig
config ARCH_INFINITY2M
    bool "SoC iNfinity2m (ARCH_MULTI_V7)" if ARCH_MULTI_V7
    select SOC_BUS
    select ARM_GIC
    select VFP
    select VFPv3
    select WIRELESS_EXT if WIRELESS && NET
    select WEXT_PRIV    if WIRELESS && NET
    help
      Support for iNfinity2m SoC

config INFINITY2M_FPGA
    bool "iNfinity2m FPGA environment" if ARCH_INFINITY2M
    depends on ARCH_INFINITY2M
    help
      Support for iNfinity2m FPGA environment

#config ANALOG_PD_XINDIGPLL
#    bool "Power down xindigpll at boot"
#    help
#      Turn off xindigpll at kerenl boot procedure

#config ANALOG_PD_ARMPLL
#    bool "Power down armpll at boot"
#    help
#      Turn off armpll at kerenl boot procedure

config ANALOG_PD_AUDIO
    bool "Power down audio at boot"
    help
      Turn off AUDIO at kerenl boot procedure

config ANALOG_PD_EMAC
    bool "Power down EMAC at boot"
    help
      Turn off EMAC at kerenl boot procedure

config ANALOG_PD_HDMI_ATOP
    bool "Power down HDMI_ATOP at boot"
    help
      Turn off HDMI_ATOP at kerenl boot procedure

config ANALOG_PD_IDAC_ATOP
    bool "Power down IDAC_ATOP at boot"
    help
      Turn off IDAC_ATOP at kerenl boot procedure

config ANALOG_PD_IDAC_LPLL
    bool "Power down IDAC_LPLL at boot"
    help
      Turn off IDAC_LPLL at kerenl boot procedure

config ANALOG_PD_DISP_LPLL
    bool "Power down DISP_LPLL at boot"
    help
      Turn off DISP_LPLL at kerenl boot procedure

config ANALOG_PD_MIPI_DPHY_TX_TOP
    bool "Power down MIPI_DPHY_TX_TOP at boot"
    help
      Turn off MIPI_DPHY_TX_TOP at kerenl boot procedure

#config ANALOG_PD_MPLL
#    bool "Power down MPLL at boot"
#    help
#      Turn off MPLL at kerenl boot procedure

config ANALOG_PD_SATA_ATOP
    bool "Power down SATA_ATOP at boot"
    help
      Turn off SATA_ATOP at kerenl boot procedure

config ANALOG_PD_UPLL_0
    bool "Power down UPLL_0 at boot"
    help
      Turn off UPLL_0 at kerenl boot procedure

config ANALOG_PD_UPLL_1
    bool "Power down UPLL_1 at boot"
    help
      Turn off UPLL_1 at kerenl boot procedure

config ANALOG_PD_USB20_P1
    bool "Power down USB20_P1 at boot"
    help
      Turn off USB20_P1 at kerenl boot procedure

config ANALOG_PD_USB20_P2
    bool "Power down USB20_P2 at boot"
    help
      Turn off USB20_P2 at kerenl boot procedure

config ANALOG_PD_USB20_P3
    bool "Power down USB20_P3 at boot"
    help
      Turn off USB20_P3 at kerenl boot procedure

config SS_PROFILING_TIME
    bool "Record timestamp in sram"
    default n
```

## sigmastar/kernel/4.9.84/arch/arm/mach-sstar/infinity3/Kconfig
```kconfig
config ARCH_INFINITY3
    bool "SoC iNfinity3 (ARCH_MULTI_V7)" if ARCH_MULTI_V7
    select SOC_BUS
    select ARM_GIC        
    select VFP
    select VFPv3
    select WIRELESS_EXT if WIRELESS && NET
    select WEXT_PRIV    if WIRELESS && NET
    help
      Support for iNfinity3 SoC
```

## sigmastar/kernel/4.9.84/arch/arm/mach-sstar/infinity5/Kconfig
```kconfig
config ARCH_INFINITY5
    bool "SoC iNfinity5 (ARCH_MULTI_V7)" if ARCH_MULTI_V7
    select SOC_BUS
    select ARM_GIC
    select VFP
    select VFPv3
    select WIRELESS_EXT if WIRELESS && NET
    select WEXT_PRIV    if WIRELESS && NET
    help
      Support for iNfinity5 SoC

config INFINITY5_FPGA
    bool "iNfinity5 FPGA environment" if ARCH_INFINITY5
    depends on ARCH_INFINITY5
    help
      Support for iNfinity5 FPGA environment
```

## sigmastar/kernel/4.9.84/arch/arm/mach-sstar/infinity6b0/Kconfig
```kconfig
config ARCH_INFINITY6B0
    bool "SoC iNfinity6b0 (ARCH_MULTI_V7)" if ARCH_MULTI_V7
    select SOC_BUS
    select ARM_GIC        
    select VFP
    select VFPv3
    select WIRELESS_EXT if WIRELESS && NET
    select WEXT_PRIV    if WIRELESS && NET
    help
      Support for iNfinity6b0 SoC

config SS_PROFILING_TIME
    bool "Record timestamp in sram"
    default y
```

## sigmastar/kernel/4.9.84/arch/arm/mach-sstar/infinity6e/Kconfig
```kconfig
config ARCH_INFINITY6E
    bool "SoC iNfinity6E (ARCH_MULTI_V7)" if ARCH_MULTI_V7
    select SOC_BUS
    select ARM_GIC
    select VFP
    select VFPv3
    select WIRELESS_EXT if WIRELESS && NET
    select WEXT_PRIV    if WIRELESS && NET
    help
      Support for iNfinity6E SoC

config SS_PROFILING_TIME
    bool "Record timestamp in sram"
    default y

config SS_MIU_ARBITRATION
    bool "SigmaStar MIU arbitration"
    default y
```
