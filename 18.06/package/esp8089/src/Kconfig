## sigmastar/kernel/4.9.84/drivers/mmc/Kconfig
```kconfig
#
# MMC subsystem configuration
#

menuconfig MMC
	tristate "MMC/SD/SDIO card support"
	depends on HAS_IOMEM
	help
	  This selects MultiMediaCard, Secure Digital and Secure
	  Digital I/O support.

	  If you want MMC/SD/SDIO support, you should say Y here and
	  also to your specific host controller driver.

config SS_FAST_MMC
	bool
	default y
	depends on MMC != n
	help
	  This make insert module faster with busy waiting on 100Hz system.

config MMC_DEBUG
	bool "MMC debugging"
	depends on MMC != n
	help
	  This is an option for use by developers; most people should
	  say N here.  This enables MMC core and driver debugging.

if MMC

source "drivers/mmc/core/Kconfig"

source "drivers/mmc/card/Kconfig"

source "drivers/mmc/host/Kconfig"

endif # MMC
```

## sigmastar/kernel/4.9.84/drivers/sstar/Kconfig
```kconfig
menuconfig MSTAR_DRIVERS
    bool "SStar SoC platform drivers"
    depends on ARCH_SSTAR
    default n

menuconfig CAM_DRIVERS
    bool "SStar Cam drivers"
    depends on MSTAR_DRIVERS
    default n
if ( CAM_DRIVERS )
source "drivers/sstar/camdriver/Kconfig"
endif

menuconfig DLA_DRIVER
    bool "SStar DLA driver"
    depends on MSTAR_DRIVERS
    default n
if ( DLA_DRIVER )
source "drivers/sstar/cambricon/Kconfig"
endif

if ( MSTAR_DRIVERS )

source "drivers/sstar/irqchip/Kconfig"
source "drivers/sstar/clocksource/Kconfig"
source "drivers/sstar/msys/Kconfig"
source "drivers/sstar/serial/Kconfig"
source "drivers/sstar/clk/Kconfig"
source "drivers/sstar/flash_isp/Kconfig"
source "drivers/sstar/pwm/Kconfig"
source "drivers/sstar/spinand/Kconfig"
source "drivers/sstar/spi/Kconfig"

source "drivers/sstar/include/$SSTAR_CHIP_NAME/Kconfig"

source "drivers/sstar/ir/Kconfig"
source "drivers/sstar/i2c/Kconfig"
source "drivers/sstar/gpio/Kconfig"
source "drivers/sstar/padmux/Kconfig"
source "drivers/sstar/rtc/Kconfig"
source "drivers/sstar/watchdog/Kconfig"
source "drivers/sstar/sar/Kconfig"
source "drivers/sstar/mma_heap/Kconfig"
source "drivers/sstar/netphy/Kconfig"
source "drivers/sstar/voltage/Kconfig"
source "drivers/sstar/iopower/Kconfig"

endif
```

## sigmastar/kernel/4.9.84/drivers/sstar/bdma/Kconfig
```kconfig
config MS_BDMA
	bool "Mstar BDMA driver"
	default n
	help

config MS_BDMA_LINE_OFFSET_ON
    bool "BDMA Line-Offset Enable"
    depends on MS_BDMA
    default n
    help
```
