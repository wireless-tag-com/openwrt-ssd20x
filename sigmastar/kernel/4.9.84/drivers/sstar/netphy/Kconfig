## sigmastar/kernel/4.9.84/drivers/sstar/spinand/Kconfig
```kconfig
config MS_SPINAND
  select MTD_NAND
  tristate "SPI NAND"
  default n

---help---
Enable compilation option for driver SPI NAND Flash.

if MS_SPINAND
config SS_SPINAND_WP
    bool "SPINAND Flash Write Protect Support"
    default n
    depends on MS_SPINAND
    help
      Support SPINAND flash write protect function.
endif

if MS_SPINAND
choice
	prompt "READ"
	default AUTO_DETECT
config AUTO_DETECT
  bool "Use fast read"
config NAND_QUAL_READ
	bool "Use quad write"
endchoice


endif
if MS_SPINAND
choice
	prompt "WRITE"
	default AUTO_DETECT_WRITE
config AUTO_DETECT_WRITE
  bool "Use fast write"
config NAND_QUAL_WRITE
	bool "Use quad write"
endchoice
endif
```

## sigmastar/kernel/4.9.84/drivers/sstar/usb/Kconfig
```kconfig
config MS_USB_OLD_PLATFORM
    tristate "USB support for platform"
    depends on CONFIG_USB_SUPPORT
```

## sigmastar/kernel/4.9.84/drivers/sstar/usb/gadget/udc/usb20/Kconfig
```kconfig
config USB_GADGET_SSTAR_DEVICE
        tristate "Sstar USB 2.0 Device Controller"
        help
                Sstar USB device

config USB_AVOID_SHORT_PACKET_IN_BULK_OUT_WITH_DMA_FOR_ETHERNET
        boolean "Avoid short packet in bulk out with DMA for ethernet"
        depends on USB_GADGET_SSTAR_DEVICE

config USB_DEBUG_MESSAGE
        boolean "Enable debug messages"
        depends on USB_GADGET_SSTAR_DEVICE

config USB_FPGA_VERIFICATION
        boolean "FPGA verification only"
        depends on USB_GADGET_SSTAR_DEVICE

config USB_CHARGER_DETECT
        boolean "Charger detection"
        depends on USB_GADGET_SSTAR_DEVICE
        #default y
config USB_ENABLE_UPLL
        boolean "Enable clock for controller"
        depends on USB_GADGET_SSTAR_DEVICE
```

## sigmastar/kernel/4.9.84/drivers/sstar/vcore_dvfs/Kconfig
```kconfig
config VCORE_DVFS
        tristate "vcore_dvfs driver"
        default y if ARCH_INFINITY2
        help
          Say Y here to enable the driver for the vcore.

          If unsure, say Y.

          To compile this driver as a module, choose M here: the
          module will be called vcore_dvfs.
```

## sigmastar/kernel/4.9.84/drivers/sstar/voltage/Kconfig
```kconfig
config SS_VOLTAGE_CTRL
    tristate "SStar Voltage Control"
    depends on MS_GPIO && !ARCH_INFINITY2
    default y
    help
```

## sigmastar/kernel/4.9.84/drivers/sstar/watchdog/Kconfig
```kconfig
config MS_WATCHDOG
        tristate "watchdog driver"
        help
          Say Y here to enable the driver for the watchdog.

          If unsure, say Y.

          To compile this driver as a module, choose M here: the
          module will be called mdrv_wdt.
```
