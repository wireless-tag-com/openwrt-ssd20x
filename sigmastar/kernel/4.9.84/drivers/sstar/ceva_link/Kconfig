## sigmastar/kernel/4.9.84/drivers/sstar/miu/Kconfig
```kconfig
config MSTAR_MIU

tristate "MSTAR MIU"

help
    MStar miu driver
default n

if MSTAR_MIU
choice
	prompt "MIU_PROTECT"
	default SSC007A_S01A
config SSC007A_S01A
 bool "ssc007a-s01a"
endchoice


endif
    
```

## sigmastar/kernel/4.9.84/drivers/sstar/mma_heap/Kconfig
```kconfig
config MSTAR_MMAHEAP
bool  "MMA HEAP"
select MSTAR_MIU
default n
 
help
    MStar MMA HEAP driver function
    
```

## sigmastar/kernel/4.9.84/drivers/sstar/msys/Kconfig
```kconfig
config MS_MSYS
    bool "msys api"
    default y
    
config MS_ZEN
    bool
    depends on MS_MSYS
    default y

config MS_MSYS_LOG
    bool "Log Redirection"
    depends on MS_MSYS
    default n

config MSYS_PERF_TEST
    bool "sysfs:perf test"
    depends on MS_MSYS
    default n

config MSYS_BENCH_MEMORY_FUNC
    bool "ioctl:bench memory function"
    depends on MS_MSYS
    default n

config MSYS_MIU_PROTECT
    bool "sysfs:MIU protest"
    depends on MS_MSYS
    default n

config MSYS_DMEM_SYSFS_ALL
    bool "add more dmem sysfs node"
    depends on MS_MSYS
    default n
```
